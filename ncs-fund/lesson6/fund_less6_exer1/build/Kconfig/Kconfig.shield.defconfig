## ncs-fund/lesson6/fund_less6_exer1/build/Kconfig/Kconfig.shield.defconfig
```kconfig
osource "c:/users/guest/documents/nrf_lessons/nrf_lessons/ncs-fund/lesson6/fund_less6_exer1/boards/shields/*/Kconfig.defconfig"
osource "C:/ncs/v2.5.1/nrf/boards/shields/*/Kconfig.defconfig"
```
